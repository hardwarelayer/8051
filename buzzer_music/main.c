/************************************************************************  
[File name] C51 music program (Apricot osmanthus)
[Function] Playing music through a single chip microcomputer  
/**********************************************************************/   
#include <REG52.H>    
#include <INTRINS.H>    
//This example uses 89C52, the crystal oscillator is 12MHZ
//How to program music code is actually very simple, you can see the following code.
//The frequency constant is the pitch in the music term, and the beat constant is how many beats in the music term;
//So take out the score, try it out!

//Buzzer connected to P21-SCL, use a jumper named P11 to connected it with NPN transistor(via a 1K resistor), 
//which supply power to GND pin of buzzer. VCC of buzzer connected to power source
sbit Beep =  P2^1 ; 
   
unsigned char n=0;  //n beat variable
unsigned char code music_tab[] ={   
	0x18, 0x30, 0x1C , 0x10, //The format is: frequency constant, beat constant, frequency constant, beat constant,
	0x20, 0x40, 0x1C , 0x10,   
	0x18, 0x10, 0x20 , 0x10,   
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	0x18, 0x80, 0x00   
};   
   
void int0()  interrupt 1   //Control the beat with interrupt 0    
{
  TH0=0xd8;   
  TL0=0xef;   
  n--;   
}   
   
void delay (unsigned char m)   //Control frequency delay    
{
  unsigned i=3*m;   
  while(--i);   
}

void delayms(unsigned char a)  //ms delay sub routine
{
  while(--a);
}
   
void main()
{
  unsigned char p,m;   //m frequency variable
  unsigned char i=0;
  
  TMOD &= 0x0f;   
  TMOD |= 0x01;   
  TH0 = 0xd8;
  TL0 = 0xef;
  IE = 0x82;

play:   
   while(1)   
    {   
    a:p = music_tab[i];

       if(p==0x00)
	   { //If encounter the terminator, delay 1 second, go back and start again.
		   i=0, delayms(1000); 
		   goto play;
       }     
       else if(p==0xff) 
	   { //If encounter a rest, delay 100ms, continue to the next note
		   i=i+1;
		   delayms(100), TR0=0;
		   goto a;
       } 
       else
	   { //Take the frequency constant and the beat constant
		   m=music_tab[i++], n=music_tab[i++];
       }
	   
       TR0=1;                            //Open timer 1
       while(n!=0) Beep=~Beep,delay(m);  //Wait for the beat to be completed, output audio through the P1 port (multi-channel!)    
       TR0=0;                            //Close timer 1    
    }   
}